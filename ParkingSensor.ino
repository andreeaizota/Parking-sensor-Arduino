int triggerPin=9;
int echoPin=10;
int redLed=3;
int yellowLed=5;
int greenLed=6;
float distance;
int speakerPin=8;

void setup() {
    pinMode(triggerPin,OUTPUT);
    pinMode(echoPin,INPUT);
    pinMode(redLed,OUTPUT);
    pinMode(yellowLed,OUTPUT);
    pinMode(greenLed,OUTPUT);
    pinMode(speakerPin,OUTPUT);
}

void loop() {
    digitalWrite(triggerPin,LOW);
    delayMicroseconds(2);
    digitalWrite(triggerPin,HIGH);
    delayMicroseconds(100);
    digitalWrite(triggerPin,HIGH);
    
    distance = ( pulseIn(echoPin,HIGH) /2 ) * 0.0343;
    if(distance<400 && distance>2){
        if(distance<=50){
          digitalWrite(redLed,HIGH);
          digitalWrite(yellowLed,LOW);
          digitalWrite(greenLed,LOW);
          tone(speakerPin,880,100);
          delay(100);
        }
        else if(distance<=150){
          digitalWrite(redLed,LOW);
          digitalWrite(yellowLed,HIGH);
          digitalWrite(greenLed,LOW);
          delay(100);
        }
        else{
          digitalWrite(redLed,LOW);
          digitalWrite(yellowLed,LOW);
          digitalWrite(greenLed,HIGH);
          delay(100);
        }
    } 
    delay(100);
}
